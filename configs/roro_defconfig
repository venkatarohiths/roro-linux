## configs/roro_defconfig
```kconfig
BR2_x86_64=y
BR2_TOOLCHAIN_BUILDROOT_MUSL=y
BR2_OPTIMIZE_3=y
BR2_STRIP_strip=y
BR2_ENABLE_DEBUG=n
BR2_ROOTFS_OVERLAY="../overlay"
BR2_TARGET_GENERIC_HOSTNAME="roro"
BR2_TARGET_GENERIC_ISSUE="Roro Linux"
BR2_INIT_BUSYBOX=y
BR2_SYSTEM_BIN_SH_BUSYBOX=y
BR2_LINUX_KERNEL=y
BR2_LINUX_KERNEL_LATEST_VERSION=y
BR2_LINUX_KERNEL_USE_CUSTOM_CONFIG=y
BR2_LINUX_KERNEL_CUSTOM_CONFIG_FILE="../configs/linux.config"
BR2_TARGET_ROOTFS_EXT2=y
BR2_TARGET_ROOTFS_EXT2_4=y
BR2_TARGET_ROOTFS_SQUASHFS=y
BR2_TARGET_ROOTFS_SQUASHFS4_LZ4=y
BR2_TARGET_ROOTFS_CPIO=y
BR2_TARGET_GRUB2=y
BR2_TARGET_GRUB2_X86_64_EFI=y
BR2_PACKAGE_BUSYBOX_SHOW_OTHERS=y
BR2_PACKAGE_DROPBEAR=y
BR2_PACKAGE_IPROUTE2=y
BR2_PACKAGE_IPTABLES=y
BR2_PACKAGE_WGET=y
BR2_PACKAGE_CA_CERTIFICATES=y
BR2_ROOTFS_POST_BUILD_SCRIPT="../scripts/post-build.sh"
BR2_ROOTFS_POST_IMAGE_SCRIPT="../scripts/post-image.sh"
```

## configs/roro_i386_micro_defconfig
```kconfig
BR2_i386=y
BR2_x86_i486=y
BR2_TOOLCHAIN_BUILDROOT_MUSL=y
BR2_TARGET_GENERIC_HOSTNAME="roro-micro"
BR2_TARGET_GENERIC_ISSUE="Roro Linux Micro"
BR2_ROOTFS_OVERLAY="../overlay"
BR2_INIT_BUSYBOX=y
BR2_LINUX_KERNEL=y
BR2_LINUX_KERNEL_USE_DEFCONFIG=y
BR2_LINUX_KERNEL_DEFCONFIG="i386"
BR2_TARGET_ROOTFS_CPIO=y
BR2_TARGET_ROOTFS_EXT2=y
BR2_TARGET_ROOTFS_EXT2_SIZE="64M"
BR2_PACKAGE_BUSYBOX_SHOW_OTHERS=y
```

## configs/roro_x86_64_tiny_defconfig
```kconfig
BR2_x86_64=y
BR2_x86_core2=y
BR2_TOOLCHAIN_BUILDROOT_MUSL=y
BR2_TARGET_GENERIC_HOSTNAME="roro"
BR2_TARGET_GENERIC_ISSUE="Roro Linux"
BR2_ROOTFS_OVERLAY="../overlay"
BR2_INIT_BUSYBOX=y
BR2_PACKAGE_BUSYBOX_SHOW_OTHERS=y
BR2_LINUX_KERNEL=y
BR2_LINUX_KERNEL_USE_DEFCONFIG=y
BR2_LINUX_KERNEL_DEFCONFIG="x86_64"
BR2_LINUX_KERNEL_NEEDS_HOST_OPENSSL=y
BR2_LINUX_KERNEL_NEEDS_HOST_LIBELF=y
BR2_TARGET_ROOTFS_EXT2=y
BR2_TARGET_ROOTFS_EXT2_4=y
BR2_TARGET_ROOTFS_EXT2_SIZE="96M"
BR2_TARGET_ROOTFS_CPIO=y
BR2_PACKAGE_DROPBEAR=y
BR2_PACKAGE_CA_CERTIFICATES=y
BR2_SYSTEM_BIN_SH_BUSYBOX=y
# keep image tiny: no X11/Wayland stack
# keep networking lean
BR2_PACKAGE_IPROUTE2=y
BR2_PACKAGE_IFUPDOWN_SCRIPTS=y

BR2_TARGET_ROOTFS_ISO9660=y


BR2_SSP_NONE=y
BR2_RELRO_NONE=y
```
